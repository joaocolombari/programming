## CMakeLists.txt
```
# SPDX-License-Identifier: Apache-2.0

cmake_minimum_required(VERSION 3.20.0)
find_package(Zephyr REQUIRED HINTS $ENV{ZEPHYR_BASE})
project(hallo_world)

target_sources(app PRIVATE src/main.c)
target_sources_ifdef(CONFIG_MYFUNCTION app PRIVATE src/myfunction.c)
```

## Kconfig
```
source "Kconfig.zephyr"
config MYFUNCTION
	bool "Enable my function"
default n
```

## prj.conf
```kconfig
CONFIG_MYFUNCTION=y
# CONFIG_LOG=y
# CONFIG_USE_SEGGER_RTT=y
# CONFIG_RTT_CONSOLE=y
# CONFIG_UART_CONSOLE=n
```

## nrf5340_audio_dk_nrf5340_cpuapp.overlay
```dts
// To get started, press Ctrl+Space (or Option+Esc) to bring up the completion menu and view the available nodes.

// You can also use the buttons in the sidebar to perform actions on nodes.
// Actions currently available include:

// * Enabling / disabling the node
// * Adding the bus to a bus
// * Removing the node
// * Connecting ADC channels

// For more help, browse the DeviceTree documentation at https://docs.zephyrproject.org/latest/guides/dts/index.html
// You can also visit the nRF DeviceTree extension documentation at https://nrfconnect.github.io/vscode-nrf-connect/devicetree/nrfdevicetree.html

&uart0 {
	current-speed = <9600>;
};
```

## src/main.c
```c
#include <zephyr/kernel.h>
#include <zephyr/sys/printk.h>

#ifdef CONFIG_MYFUNCTION
#include "myfunction.h"
#endif

// 1kms = 1s
#define SLEEP_TIME_MS 1000 

int main(void)
{
	int a = 3, b = 4;
	
	while (1) 
	{
		#ifdef CONFIG_MYFUNCTION
		int a = 3, b = 4;
			printk("The sum of %d and %d is %d\n Hello World!!\n\n", a, b, sum(a,b));
		#else
			printk("MYFUNCTION not enabled\r\n");
			return;
		#endif
		k_msleep(1000);
	}
	return 0;
}
```
