## Tiresias/cs_driver/build/Kconfig/Kconfig.shield.defconfig
```kconfig
osource "/Users/joaovitor/my_boards/boards/shields/*/Kconfig.defconfig"
osource "/opt/nordic/ncs/v2.6.0/nrf/boards/shields/*/Kconfig.defconfig"
```

## nordic/BLE_fundamentals/lesson1/blefund_less1_exer1/build/Kconfig/Kconfig.shield.defconfig
```kconfig
osource "/Users/joaovitor/Documents/VSCode/nordic/BLE_fundamentals/lesson1/blefund_less1_exer1/boards/shields/*/Kconfig.defconfig"
osource "/Users/joaovitor/Downloads/blefund_less1_exer1/boards/shields/*/Kconfig.defconfig"
osource "/Users/joaovitor/Documents/VSCode/nordic/BLE_fundamentals/lesson1/blefund_less1_exer1/./boards/shields/*/Kconfig.defconfig"
osource "/opt/nordic/ncs/v2.5.0-rc1/nrf/boards/shields/*/Kconfig.defconfig"
```

## nordic/BLE_fundamentals/lesson2/blefund_less2_exer1_solution/build/Kconfig/Kconfig.shield
```kconfig
osource "/Users/joaovitor/Documents/VSCode/nordic/BLE_fundamentals/lesson2/blefund_less2_exer1_solution/boards/shields/*/Kconfig.shield"
osource "/Users/joaovitor/Documents/VSCode/nordic/BLE_fundamentals/lesson2/blefund_less2_exer1_solution/./boards/shields/*/Kconfig.shield"
osource "/opt/nordic/ncs/v2.5.0-rc1/nrf/boards/shields/*/Kconfig.shield"
```

## nordic/BLE_fundamentals/lesson2/blefund_less2_exer2_solution/build/Kconfig/Kconfig.shield.defconfig
```kconfig
osource "/Users/joaovitor/Documents/VSCode/nordic/BLE_fundamentals/lesson2/blefund_less2_exer2_solution/boards/shields/*/Kconfig.defconfig"
osource "/opt/nordic/ncs/v2.5.0-rc1/nrf/boards/shields/*/Kconfig.defconfig"
```

## nordic/BLE_fundamentals/lesson3/blefund_less3_exer1/build/Kconfig/Kconfig.shield
```kconfig
osource "/Users/joaovitor/Documents/VSCode/nordic/BLE_fundamentals/lesson3/blefund_less3_exer1/boards/shields/*/Kconfig.shield"
osource "/opt/nordic/ncs/v2.5.0-rc1/nrf/boards/shields/*/Kconfig.shield"
```

## nordic/BLE_fundamentals/lesson3/blefund_less3_exer2/build/Kconfig/Kconfig.shield.defconfig
```kconfig
osource "/Users/joaovitor/Documents/VSCode/nordic/BLE_fundamentals/lesson3/blefund_less3_exer2/boards/shields/*/Kconfig.defconfig"
osource "/opt/nordic/ncs/v2.5.0-rc1/nrf/boards/shields/*/Kconfig.defconfig"
```

## nordic/BLE_fundamentals/lesson4/blefund_less4_exer3/build/Kconfig/Kconfig.shield
```kconfig
osource "/Users/joaovitor/Documents/VSCode/nordic/BLE_fundamentals/lesson4/blefund_less4_exer3/boards/shields/*/Kconfig.shield"
osource "/opt/nordic/ncs/v2.5.0-rc1/nrf/boards/shields/*/Kconfig.shield"
```

## nordic/BLE_fundamentals/lesson5/blefund_less5_exer1/build/Kconfig/Kconfig.shield
```kconfig
osource "/Users/joaovitor/Documents/VSCode/nordic/BLE_fundamentals/lesson5/blefund_less5_exer1/boards/shields/*/Kconfig.shield"
osource "/Users/joaovitor/Documents/VSCode/nordic/BLE_fundamentals/lesson5/blefund_less5_exer1/./boards/shields/*/Kconfig.shield"
osource "/opt/nordic/ncs/v2.5.0-rc1/nrf/boards/shields/*/Kconfig.shield"
```

## nordic/BLE_fundamentals/lesson5/blefund_less5_exer2/build/Kconfig/Kconfig.shield
```kconfig
osource "/Users/joaovitor/Documents/VSCode/nordic/BLE_fundamentals/lesson5/blefund_less5_exer2/boards/shields/*/Kconfig.shield"
osource "/opt/nordic/ncs/v2.5.0-rc1/nrf/boards/shields/*/Kconfig.shield"
```

## nordic/nRF_connect_sdk_intermediate/lesson_2/2.3/build/Kconfig/Kconfig.shield
```kconfig
osource "/Users/joaovitor/Documents/VSCode/nordic/nRF_connect_sdk_intermediate/lesson_2/2.3/boards/shields/*/Kconfig.shield"
osource "/opt/nordic/ncs/v2.6.0/nrf/boards/shields/*/Kconfig.shield"
```

## nordic/nRF_connect_sdk_intermediate/lesson_4/4.2/build/Kconfig/Kconfig.shield
```kconfig
osource "/Users/joaovitor/my_boards/boards/shields/*/Kconfig.shield"
osource "/Users/joaovitor/Documents/VSCode/nordic/nRF_connect_sdk_intermediate/lesson_4/4.2/boards/shields/*/Kconfig.shield"
osource "/opt/nordic/ncs/v2.6.0/nrf/boards/shields/*/Kconfig.shield"
```

## nordic/nRF_connect_sdk_intermediate/lesson_5/accel_polling/build/Kconfig/Kconfig.shield.defconfig
```kconfig
osource "/Users/joaovitor/my_boards/boards/shields/*/Kconfig.defconfig"
osource "/Users/joaovitor/Documents/VSCode/nordic/nRF_connect_sdk_intermediate/lesson_5/accel_polling/boards/shields/*/Kconfig.defconfig"
osource "/opt/nordic/ncs/v2.6.0/nrf/boards/shields/*/Kconfig.defconfig"
```

## nordic/nRF_connect_sdk_intermediate/lesson_6/6.1/build/Kconfig/Kconfig.shield.defconfig
```kconfig
osource "/Users/joaovitor/my_boards/boards/shields/*/Kconfig.defconfig"
osource "/Users/joaovitor/Documents/VSCode/nordic/nRF_connect_sdk_intermediate/lesson_6/6.1/boards/shields/*/Kconfig.defconfig"
osource "/opt/nordic/ncs/v2.6.0/nrf/boards/shields/*/Kconfig.defconfig"
```

## nordic/nRF_connect_sdk_intermediate/lesson_6/renato_gaucho/build/Kconfig/Kconfig.shield.defconfig
```kconfig
osource "/Users/joaovitor/my_boards/boards/shields/*/Kconfig.defconfig"
osource "/Users/joaovitor/Documents/vscode-study/nordic/nRF_connect_sdk_intermediate/lesson_6/renato_gaucho/boards/shields/*/Kconfig.defconfig"
osource "/opt/nordic/ncs/v2.6.0/nrf/boards/shields/*/Kconfig.defconfig"
```

## nordic/nRF_connect_sdk_intermediate/lesson_7/exercise/build/Kconfig/Kconfig.shield.defconfig
```kconfig
osource "/Users/joaovitor/my_boards/boards/shields/*/Kconfig.defconfig"
osource "/Users/joaovitor/Documents/VSCode/nordic/nRF_connect_sdk_intermediate/lesson_7/exercise/boards/shields/*/Kconfig.defconfig"
osource "/opt/nordic/ncs/v2.6.0/nrf/boards/shields/*/Kconfig.defconfig"
```

## nordic/nRF_connect_sdk_intermediate/lesson_7/my_custom_adxl345/custom_adxl345_driver/dts/bindings/custom,adxl345.yaml
```yaml
# Copyright (c) 2023, Nordic Semiconductor
# SPDX-License-Identifier: Apache-2.0

description: ADXL345 three axis acc

compatible: "custom,adxl345"

include: spi-device.yaml
```

## nordic/nRF_connect_sdk_intermediate/lesson_7/my_custom_adxl345/custom_adxl345_driver/zephyr/Kconfig
```kconfig
# BME280 custom driver options 

# Copyright (c) 2019 Nordic Semiconductor
# SPDX-License-Identifier: Apache-2.0

menuconfig CUSTOM_ADXL345_DRIVER
	bool "ADXL345 Three Axis accelerometer"
	depends on SPI

if CUSTOM_ADXL345_DRIVER

source "subsys/logging/Kconfig.template.log_config"
# STEP 3 - Add a custom driver initialization priority
config DRIVER_INIT_PRIORITY
	int "Init priority"
	default 71
	help
	  Custom device driver initialization priority, This needs be more than CONFIG_SPI_INIT_PRIORITY.

endif
```

## nordic/nRF_connect_sdk_intermediate/lesson_8/8.3/build/Kconfig/Kconfig.shield
```kconfig
osource "/Users/joaovitor/my_boards/boards/shields/*/Kconfig.shield"
osource "/Users/joaovitor/Documents/vscode-study/nordic/nRF_connect_sdk_intermediate/lesson_8/8.3/boards/shields/*/Kconfig.shield"
osource "/opt/nordic/ncs/v2.6.0/nrf/boards/shields/*/Kconfig.shield"
```

## nordic/projects/blinky_pwm/build/Kconfig/Kconfig.shield.defconfig
```kconfig
osource "/Users/joaovitor/Documents/VSCode/nordic/blinky_pwm/boards/shields/*/Kconfig.defconfig"
osource "/opt/nordic/ncs/v2.5.0-rc1/nrf/boards/shields/*/Kconfig.defconfig"
```

## nordic/projects/lesson_6/fund_less6_exer2_solution/build/Kconfig/Kconfig.shield
```kconfig
osource "/Users/joaovitor/Documents/VSCode/nordic/projects/lesson_6/fund_less6_exer2_solution/boards/shields/*/Kconfig.shield"
osource "/opt/nordic/ncs/v2.5.0-rc1/nrf/boards/shields/*/Kconfig.shield"
```

## spi/spi_mine/Torbjørn/ncs-spi-master-slave-example/build/Kconfig/Kconfig.shield.defconfig
```kconfig
osource "/Users/joaovitor/Documents/VSCode/Tiresias/spi_mine/Torbjørn/ncs-spi-master-slave-example/boards/shields/*/Kconfig.defconfig"
osource "/opt/nordic/ncs/v2.6.0-rc2/nrf/boards/shields/*/Kconfig.defconfig"
```

## spi/spi_mine/Torbjørn/spi_master/build/Kconfig/Kconfig.shield
```kconfig
osource "/Users/joaovitor/Documents/VSCode/Tiresias/spi_mine/Torbjørn/spi_master/boards/shields/*/Kconfig.shield"
osource "/opt/nordic/ncs/v2.6.0-rc2/nrf/boards/shields/*/Kconfig.shield"
```

## spi/spi_mine/Torbjørn/spi_slave/build/Kconfig/Kconfig.shield.defconfig
```kconfig
osource "/Users/joaovitor/Documents/VSCode/Tiresias/spi_mine/Torbjørn/spi_slave/boards/shields/*/Kconfig.defconfig"
osource "/opt/nordic/ncs/v2.6.0-rc2/nrf/boards/shields/*/Kconfig.defconfig"
```
